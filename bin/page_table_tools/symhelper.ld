INCLUDE default_ld_script.ld

pgdir_shift = 0xffffffff826f1a6c;
boot_cpu_data = 0xffffffff82b63640;
physical_mask = 0xffffffff82708310;
sme_me_mask = 0xffffffff8284def8;
ptrs_per_p4d = 0xffffffff826f1a68;
pv_ops = 0xffffffff8283cc40;
page_offset_base = 0xffffffff826f1a60;
__flush_tlb_all = 0xffffffff8107f1d0;