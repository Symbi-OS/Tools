INCLUDE default_ld_script.ld

printk = 0xffffffff81ca81f7;
pgdir_shift = 0xffffffff826f1a6c;
boot_cpu_data = 0xffffffff82b63640;
physical_mask = 0xffffffff82708310;
sme_me_mask = 0xffffffff8284def8;
ptrs_per_p4d = 0xffffffff826f1a68;
pv_ops = 0xffffffff8283cc40;
page_offset_base = 0xffffffff826f1a60;
phys_base = 0xffffffff8281a010;
find_get_pid = 0xffffffff8110cd60;
put_pid = 0xffffffff8110cc10;
pid_task = 0xffffffff8110ca30;
current_task = 0x0000000000017bc0;
event_class_syscall_exit = 0xffffffff82b0de20;
exit_syscall_print_funcs = 0xffffffff829c2bc0;
event_class_syscall_enter = 0xffffffff82b0de80;
enter_syscall_print_funcs = 0xffffffff829c2be0;
ex_handler_clear_fs = 0xffffffff8107d750;
ex_handler_default = 0xffffffff8107d700;
rdt_enable_key = 0xffffffff82eb7350;
rdt_alloc_enable_key = 0xffffffff82eb7330;
rdt_mon_enable_key = 0xffffffff82eb7340;
cpu_current_top_of_stack = 0x0000000000017b90;
__switch_to_xtra = 0xffffffff81038360;
__tracepoint_x86_fpu_regs_deactivated = 0xffffffff82b1c660;
switch_to_cond_stibp = 0xffffffff82e7dcf0;
__SCK__tp_func_x86_fpu_regs_deactivated = 0xffffffff82830580;
cpu_number = 0x0000000000011568;
__task_pid_nr_ns = 0xffffffff8110cb80;
this_cpu_off = 0x0000000000011570;
pqr_state = 0x0000000000017db0;
copy_process = 0xffffffff810e5fd0;
__per_cpu_offset = 0xffffffff826f7a80;
__default_kernel_pte_mask = 0xffffffff82b63bd8;
__supported_pte_mask = 0xffffffff82b63be0;
__warn_printk = 0xffffffff81ca1f28;
__flush_tlb_all = 0xffffffff8107f1d0;
__switch_to = 0xffffffff8102b930;